#include "BluetoothA2DPSink.h" // Incluimos todas las librerias necesarias. 
#include <SPI.h>               // Usamos 4-Wire SPI porque la SH no tiene I2C.
#include <Wire.h>
#include <Adafruit_GFX.h>
#include <Adafruit_SH110X.h>
#include "AiEsp32RotaryEncoder.h"
#include <WiFi.h>              // Para radio
#include "Arduino.h"


#define OLED_MOSI     23 // (SDA (D1)) va al GPIO MOSI
#define OLED_CLK      18 // SCK GPIO
#define OLED_RST      17 // TX2 GPIO
#define OLED_DC       16 // RX2 GPIO
#define OLED_CS       5  // SS  GPIO

// setup luces con pwm fade

#define R 15 // GPIO 15, 2, 4
#define G 2
#define B 4

#define conm1 19
#define conm2 21

int brillo = 0 ; int fade = 5;

/*
Conexiones JOYSTICK
GND - GND
Vcc - 5v (Puede funcionar con 3.3V)
VRx - A0: Canal 0 del ADC // ADC1_6
VRy - A1: Canal 1 del ADC // ADC1_7
SW  - D9                  // TX0
*/

#define JX     35 //vrx --> adc1_6
#define JY     34 //vry --> adc1_7
#define JB     21 //tx0 --> pullup (valor 0,1);

#define LEDB   19 //led emparejamiento
#define LEDG   21

// Setup de codificador rotativo

#define ROTARY_ENCODER_A_PIN 14 // HSPI CLK GPIO para evitar conflicto con OLED
#define ROTARY_ENCODER_B_PIN 22
#define ROTARY_ENCODER_BUTTON_PIN 21
#define ROTARY_ENCODER_VCC_PIN -1 // va al 3.3 de la placa
#define ROTARY_ENCODER_STEPS 4

AiEsp32RotaryEncoder rotaryEncoder = AiEsp32RotaryEncoder(ROTARY_ENCODER_A_PIN, ROTARY_ENCODER_B_PIN, ROTARY_ENCODER_BUTTON_PIN, ROTARY_ENCODER_VCC_PIN, ROTARY_ENCODER_STEPS);

// Declaramos funciones que usaremos

void rotary_onButtonClick()
{
    static unsigned long lastTimePressed = 0; // Soft debouncing
    if (millis() - lastTimePressed < 500)
    {
            return;
    }
    lastTimePressed = millis();
    Serial.print("button pressed ");
    Serial.print(millis());
    Serial.println(" milliseconds after restart");
}

void rotary_loop()
{
    //dont print anything unless value changed
    if (rotaryEncoder.encoderChanged())
    {
            Serial.print("Value: ");
            Serial.println(rotaryEncoder.readEncoder());
            delay(50);
    }
    if (rotaryEncoder.isEncoderButtonClicked())
    {
            rotary_onButtonClick();
    }
}

void IRAM_ATTR readEncoderISR()
{
    rotaryEncoder.readEncoder_ISR();
}


void wifiCon() {

  // WiFi begin. Tiene varios estados (de la pagina de Arduino): 

    Serial.begin(115200);
    delay(1000);

    WiFi.mode(WIFI_STA); // Opcional
    WiFi.begin(ssid, password);
    Serial.println("\nConectando");

      if(Wifi.Status() != WL_IDLE_STATUS){

        analogWrite(G, 255); 

        delay (100); 

        analogWrite(G,0);

        delay(100); 

      }

      else if (WiFi.status() != WL_CONNECTED){

        Serial.println("WiFi conectado al ESP32"); 

        analogWrite(G, 255); 

        delay(100);

      }

    Serial.println("\nConectado a la red WiFi");
    Serial.print("IP ESP32 local: ");
    Serial.println(WiFi.localIP());


    /*
    WL_CONNECTED: assigned when connected to a WiFi network; WL_NO_SHIELD: assigned when no WiFi shield is present; 
    WL_IDLE_STATUS: it is a temporary status assigned when WiFi.begin() is called and remains active until the number of attempts expires
    WL_NO_SSID_AVAIL: assigned when no SSID are available
    WL_SCAN_COMPLETED: assigned when the scan networks is completed
    WL_CONNECT_FAILED: assigned when the connection fails for all the attempts
    WL_CONNECTION_LOST: assigned when the connection is lost
    WL_DISCONNECTED: assigned when disconnected from a network
    */

}


bool isPlaying = true; // para control de canción pause/stop.


// -------------------- Inicia la pantalla en reg 0x3F

Adafruit_SH1106G display = Adafruit_SH1106G(128, 64,OLED_MOSI, OLED_CLK, OLED_DC, OLED_RST, OLED_CS);

const unsigned char esp32bt [] PROGMEM = { // bitmap custom
	0x00, 0x00, 0x00, 0x00, 0x00, 0x00, 0x00, 0x00, 0x00, 0x00, 0x00, 0x00, 0x00, 0x00, 0x00, 0x00, 
	0x00, 0x00, 0x00, 0x03, 0x00, 0x00, 0x00, 0x00, 0x00, 0x00, 0x00, 0x00, 0x00, 0x00, 0x00, 0x00, 
	0x00, 0x00, 0x00, 0xe3, 0x0c, 0x00, 0x00, 0x00, 0x00, 0x00, 0x00, 0x00, 0x00, 0x00, 0x00, 0x00, 
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	0x00, 0x00, 0x00, 0x00, 0x00, 0x00, 0x00, 0x00, 0x00, 0x00, 0x00, 0x00, 0x00, 0x00, 0x00, 0x00
};

// Setup WIFI

const char* ssid = ""; 
const char* password = "";

void setup() {

  // inicializa el encoder

    rotaryEncoder.begin();
    rotaryEncoder.setup(readEncoderISR);
    //set boundaries and if values should cycle or not
    //in this example we will set possible values between 0 and 1000;
    bool circleValues = false;
    rotaryEncoder.setBoundaries(0, 1000, circleValues); //minValue, maxValue, circleValues true|false (when max go to min and vice versa)

    /*Rotary acceleration introduced 25.2.2021.
   * in case range to select is huge, for example - select a value between 0 and 1000 and we want 785
   * without accelerateion you need long time to get to that number
   * Using acceleration, faster you turn, faster will the value raise.
   * For fine tuning slow down.
   */
    //rotaryEncoder.disableAcceleration(); //acceleration is now enabled by default - disable if you dont need it
    rotaryEncoder.setAcceleration(150); //or set the value - larger number = more accelearation; 0 or 1 means disabled acceleration

  pinMode(LED_BUILTIN, OUTPUT);
  pinMode(R, OUTPUT); pinMode(G, OUTPUT); pinMode(B, OUTPUT);

  pinMode(JB, INPUT_PULLUP);  //activar resistencia pull up  
  pinMode(JX, INPUT_PULLUP);
  pinMode(JY, INPUT_PULLUP);

  Serial.begin(115200);

  // Inicia OLED

  display.begin(0,true); // reset sin I2C

  // Splashcreen Adafruit por estética

  display.display(); delay(1000); display.clearDisplay();

  display.drawBitmap(0, 0, esp32bt, 128, 64, 1); display.display(); delay(2500); display.clearDisplay();

  // DAC I2S configuracion 

    i2s_pin_config_t my_pin_config = {
        .bck_io_num = 27, //// BCLK 
        .ws_io_num = 26,  //// LRC pin 
        .data_out_num = 25, ///Din pin
        .data_in_num = I2S_PIN_NO_CHANGE
    };

  pinMode(conm1, INPUT_PULLUP); pinMode(conm2, INPUT_PULLUP);

  wifiCon();


}

void loop() {

  /*// esqueleto conmutador

  if (digitalRead(conm1) == HIGH && digitalRead(conm2) == LOW) // siendo comm 1 gpio x para bt
    {
      estado = 1;

    }
  else if (digitalRead(conm1) == LOW && digitalRead(conm2) == HIGH) // siendo comm 2 gpio y para WiFi
    {
      estado = 2;
    }
  
  // esqueleto switch

  while (1) {

    switch (estado) 
    {

      case 1: 
      
        btStart();
        bluetoothLoop(); // se activa bt
        break;

    
      case 2;

        wifiLoop(); // se activa wifi
        break;

    }

  }
  */

// Encoder loop

    int vol = rotaryEncoder.readEncoder(); // Asignamos valor a la lectura.

    if (rotaryEncoder.readEncoder() > 100){

          vol = 100; // Obviamente no vamos a hacer un display de 200% en el volumen. Esto limita el integer a 100.

        }

        else {

          vol = rotaryEncoder.readEncoder(); // Vuelta a lo normal.

        }


// Check conectividad a BT.

    if (WiFi.status() != WL_CONNECTED) {

      // digitalWrite(G,HIGH);

      analogWrite(G,255);
      
      display.clearDisplay();
      display.setTextSize(1);
      
      display.clearDisplay();
      display.setCursor(35,0); // Centrado. Valores en pantalla --> (x,y)
      display.setTextSize(2);
      display.println("RADIO ON");

      display.setTextSize(1);
      display.setCursor(0,12); display.println("....................."); display.println();

      //display.setCursor(0,20);
      //display.print("Volumen: ");
      //display.print(vol); 
      
      /*if (rotaryEncoder.readEncoder() > 102) {
        
        display.println("% (+)"); // mostramos valor mayor del recomendado.
      
      }

      else{

        display.println("%");

      }

      display.println();  

      display.print("Cancion: ");
      display.println(songTitle);
      

      display.print("Artista: ");
      display.println(artistName);
      display.println();

      /*display.print("Album: ");
      display.println(albumName);*/

      display.display();

    // defino valores iniciales joystick

     int pos_x = 0;
     int pos_y = 0;
     bool boton = false;
     
     // Lectura del joystick
     pos_x = analogRead(JX);
     delay(20);            // pausa entre lecturas analógicas (necesaria)
     pos_y = analogRead(JY);
     boton = digitalRead(JB);
	   //digitalWrite(LED, JB); // controla el led con el estado del botón

     if (pos_x > 3000){

        a2dp_sink.next();
        delay(500);
        //break;
        
     }
     if (pos_x < 2500) {

        a2dp_sink.previous();
       delay(500);
       //break;

     }

     if (boton == LOW) {

        if (isPlaying == true){
        a2dp_sink.pause();
        
      
      }

      else{

       a2dp_sink.play();

      }
      
     }

    rotary_loop(); // loop para el codificador. constantemente actualizamos posición y volúmen.

      a2dp_sink.set_volume(rotaryEncoder.readEncoder());
      delay(50);   

    delay(50);

    }

    else {

      analogWrite(G, 0); 

      display.clearDisplay();

      display.clearDisplay();
      display.setCursor(35,0); // Centrado. Valores en pantalla --> (x,y)
      display.setTextSize(2);
      display.println("BT OFF");



    }


}